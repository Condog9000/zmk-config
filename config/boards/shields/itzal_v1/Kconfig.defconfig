## config/boards/shields/itzal_v1/Kconfig.defconfig
```kconfig
# Copyright (c) 2020 The ZMK Contributors
# SPDX-License-Identifier: MIT

if SHIELD_ITZAL_V1

config ZMK_KEYBOARD_NAME
	default "Itzal_v1"

endif
```

## config/boards/shields/itzal_v1/Kconfig.shield
```kconfig
# Copyright (c) 2020 The ZMK Contributors
# SPDX-License-Identifier: MIT

config SHIELD_ITZAL_V1
	def_bool $(shields_list_contains,itzal_v1)
```
